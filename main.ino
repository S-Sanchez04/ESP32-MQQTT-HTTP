#include <WiFi.h>
#include <WebServer.h>
#include <WiFiClientSecure.h>
#include <PubSubClient.h>

#include "config.h"
#include "certificates.h"

// ===========================================================
// MQTT CLIENT
// ===========================================================
WiFiClientSecure secureClient;
PubSubClient mqttClient(secureClient);

// ===========================================================
// HTTP SERVER
// ===========================================================
WebServer server(HTTP_PORT);

// Control de tiempo de movimiento
unsigned long movementEndTime = 0;
bool motorsRunning = false;

// ===========================================================
// PUBLICAR MENSAJE A AWS EN FORMATO JSON
// ===========================================================
void publishInstruction(const String& direction, int speed, int duration) {
  String json = "{";
  json += "\"direction\":\"" + direction + "\",";
  json += "\"speed\":" + String(speed) + ",";
  json += "\"duration\":" + String(duration) + ",";
  json += "\"source\":\"http\"";
  json += "}";

  mqttClient.publish(MQTT_TOPIC_CMD, json.c_str());
  Serial.println("Enviado a AWS: " + json);
}

// ===========================================================
// ===================== MOTORES =============================
// ===========================================================
void motors_stop() {
  analogWrite(ENA_PIN, 0);
  analogWrite(ENB_PIN, 0);
  motorsRunning = false;
  Serial.println("Motores detenidos");
}

void move_forward(int speed) {
  digitalWrite(IN1_PIN, HIGH);
  digitalWrite(IN2_PIN, LOW);

  digitalWrite(IN3_PIN, HIGH);
  digitalWrite(IN4_PIN, LOW);

  analogWrite(ENA_PIN, speed);
  analogWrite(ENB_PIN, speed);
}

void move_backward(int speed) {
  digitalWrite(IN1_PIN, LOW);
  digitalWrite(IN2_PIN, HIGH);

  digitalWrite(IN3_PIN, LOW);
  digitalWrite(IN4_PIN, HIGH);

  analogWrite(ENA_PIN, speed);
  analogWrite(ENB_PIN, speed);
}

void turn_left(int speed) {
  digitalWrite(IN1_PIN, LOW);
  digitalWrite(IN2_PIN, HIGH);

  digitalWrite(IN3_PIN, HIGH);
  digitalWrite(IN4_PIN, LOW);

  analogWrite(ENA_PIN, speed);
  analogWrite(ENB_PIN, speed);
}

void turn_right(int speed) {
  digitalWrite(IN1_PIN, HIGH);
  digitalWrite(IN2_PIN, LOW);

  digitalWrite(IN3_PIN, LOW);
  digitalWrite(IN4_PIN, HIGH);

  analogWrite(ENA_PIN, speed);
  analogWrite(ENB_PIN, speed);
}

// ===========================================================
// FUNCION AUXILIAR PARA AGREGAR HEADERS CORS
// ===========================================================
void addCORS() {
  server.sendHeader("Access-Control-Allow-Origin", "*");
  server.sendHeader("Access-Control-Allow-Methods", "GET, POST, OPTIONS");
  server.sendHeader("Access-Control-Allow-Headers", "*");
}

// ===========================================================
// ENDPOINTS HTTP CON PREFIJO /api/v1
// ===========================================================
void handleMove() {
  addCORS();

  if (!server.hasArg("direction") || 
      !server.hasArg("speed") || 
      !server.hasArg("duration")) 
  {
    server.send(400, "text/plain", "Missing parameters");
    return;
  }

  String direction = server.arg("direction");
  int speed = server.arg("speed").toInt();
  int duration = server.arg("duration").toInt();

  speed = constrain(speed, 0, 255);
  duration = constrain(duration, 0, 5000);

  Serial.printf("CMD HTTP: direction=%s, speed=%d, duration=%d\n",
                direction.c_str(), speed, duration);

  // Ejecutar movimiento
  if (direction == "forward") move_forward(speed);
  else if (direction == "backward") move_backward(speed);
  else if (direction == "left") turn_left(speed);
  else if (direction == "right") turn_right(speed);
  else {
    server.send(400, "text/plain", "Invalid direction");
    return;
  }

  // Límite de tiempo
  movementEndTime = millis() + duration;
  motorsRunning = true;

  // PUBLICAR A AWS
  publishInstruction(direction, speed, duration);

  server.send(200, "text/plain", "Movement started + sent to AWS");
}

void handleStop() {
  addCORS();

  motors_stop();
  publishInstruction("stop", 0, 0);
  server.send(200, "text/plain", "Stopped + sent to AWS");
}

void handleHealth() {
  addCORS();

  server.send(200, "application/json", "{\"status\":\"ok\"}");
}

// ===========================================================
// RESPONDER OPCIONES (CORS preflight)
// ===========================================================
void handleOptions() {
  addCORS();
  server.send(204); // No Content
}

// ===========================================================
// WIFI + MQTT
// ===========================================================
void connectMQTT() {
  while (!mqttClient.connected()) {
    Serial.print("Conectando a AWS IoT... ");

    if (mqttClient.connect(DEVICE_NAME)) {
      Serial.println("OK");
    } else {
      Serial.printf("Falla (%d). Reintentando...\n", mqttClient.state());
      delay(1500);
    }
  }
}

void connectWiFi() {
  Serial.printf("Conectando a WiFi (%s)...\n", WIFI_SSID);
  WiFi.begin(WIFI_SSID, WIFI_PASS);

  while (WiFi.status() != WL_CONNECTED) {
    Serial.print(".");
    delay(300);
  }

  Serial.println("\nWiFi conectado");
  Serial.print("IP: ");
  Serial.println(WiFi.localIP());
}

// ===========================================================
// SETUP
// ===========================================================
void setup() {
  Serial.begin(115200);

  // Pines motores
  pinMode(ENA_PIN, OUTPUT);
  pinMode(IN1_PIN, OUTPUT);
  pinMode(IN2_PIN, OUTPUT);
  pinMode(ENB_PIN, OUTPUT);
  pinMode(IN3_PIN, OUTPUT);
  pinMode(IN4_PIN, OUTPUT);

  motors_stop();

  connectWiFi();

  // MQTT CERTIFICATES
  secureClient.setCACert(AWS_CERT_CA);
  secureClient.setCertificate(AWS_CERT_CRT);
  secureClient.setPrivateKey(AWS_CERT_PRIVATE);

  mqttClient.setServer(MQTT_BROKER, MQTT_PORT);

  connectMQTT();

  // HTTP ROUTES CON PREFIJO /api/v1
  server.on("/api/v1/move", HTTP_ANY, handleMove);
  server.on("/api/v1/stop", HTTP_ANY, handleStop);
  server.on("/api/v1/health", HTTP_ANY, handleHealth);
  server.onNotFound([]() { addCORS(); server.send(404, "text/plain", "Not found"); });
  server.on("/api/v1/move", HTTP_OPTIONS, handleOptions);
  server.on("/api/v1/stop", HTTP_OPTIONS, handleOptions);
  server.on("/api/v1/health", HTTP_OPTIONS, handleOptions);

  server.begin();
  Serial.println("HTTP server iniciado");
}

// ===========================================================
// LOOP
// ===========================================================
void loop() {
  server.handleClient();

  if (!mqttClient.connected()) {
    connectMQTT();
  }
  mqttClient.loop();

  if (motorsRunning && millis() > movementEndTime) {
    motors_stop();
  }
}
